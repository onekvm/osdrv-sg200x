## oe-recipes/conf/layer.conf
```bitbake
BBPATH .= ":${LAYERDIR}"

BBFILES += "${LAYERDIR}/recipes-*/*/*.bb \
            ${LAYERDIR}/recipes-*/*/*.bbappend"

BBFILE_COLLECTIONS += "osdrv-sg200x"
BBFILE_PATTERN_osdrv-sg200x := "^${LAYERDIR}/"
BBFILE_PRIORITY_osdrv-sg200x = "8"

LAYERDEPENDS_osdrv-sg200x = "core onekvm-bsp"
LAYERSERIES_COMPAT_osdrv-sg200x = "wrynose"
```
